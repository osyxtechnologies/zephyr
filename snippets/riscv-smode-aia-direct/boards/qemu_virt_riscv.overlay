/*
 * SPDX-FileCopyrightText: Copyright The Zephyr Project Contributors
 *
 * SPDX-License-Identifier: Apache-2.0
 */

/delete-node/ &plic;

#include <qemu/virt-riscv-aia-smode.dtsi>

/ {
	cpus {
		riscv,isa-extensions = "i", "m", "a", "f", "d", "c", "zicsr", "zifencei", "zicntr",
				       "zkr", "smaia", "ssaia";
	};
};

&aplic {
	interrupts-extended = <&hlic0 0x09 &hlic1 0x09 &hlic2 0x09 &hlic3 0x09
			       &hlic4 0x09 &hlic5 0x09 &hlic6 0x09 &hlic7 0x09>;
	riscv,max-priority = <3>;
};
