## boards/spacemit/k3_com260/Kconfig.k3_com260
```kconfig
# SPDX-FileCopyrightText: Copyright The Zephyr Project Contributors
# SPDX-License-Identifier: Apache-2.0

config BOARD_K3_COM260
	select SOC_SPACEMIT_K3
```

## boards/spacemit/k3_com260/board.yml
```yaml
# SPDX-FileCopyrightText: Copyright The Zephyr Project Contributors
# SPDX-License-Identifier: Apache-2.0

board:
  name: k3_com260
  full_name: K3 CoM260
  vendor: spacemit
  socs:
    - name: spacemit_k3
```

## dts/bindings/cpu/spacemit,a100.yaml
```yaml
# SPDX-FileCopyrightText: Copyright The Zephyr Project Contributors
# SPDX-License-Identifier: Apache-2.0

description: SpacemiT A100 RISC-V core

compatible: "spacemit,a100"

include: riscv-common.yaml
```

## dts/bindings/cpu/spacemit,x100.yaml
```yaml
# SPDX-FileCopyrightText: Copyright The Zephyr Project Contributors
# SPDX-License-Identifier: Apache-2.0

description: SpacemiT X100 RISC-V core

compatible: "spacemit,x100"

include: riscv-common.yaml
```

## soc/spacemit/k3/Kconfig
```kconfig
# SPDX-FileCopyrightText: Copyright The Zephyr Project Contributors
# SPDX-License-Identifier: Apache-2.0

config SOC_SPACEMIT_K3
	select RISCV
	select RISCV_PRIVILEGED
	select RISCV_HAS_AIA
	select RISCV_SOC_HAS_GP_RELATIVE_ADDRESSING
	select INCLUDE_RESET_VECTOR
```

## soc/spacemit/k3/Kconfig.defconfig
```kconfig
# SPDX-FileCopyrightText: Copyright The Zephyr Project Contributors
# SPDX-License-Identifier: Apache-2.0

if SOC_SPACEMIT_K3

config SYS_CLOCK_HW_CYCLES_PER_SEC
	default 24000000

config RISCV_SOC_INTERRUPT_INIT
	default y

config 2ND_LVL_ISR_TBL_OFFSET
	default 12

# The interrupt controllers are reached through the supervisor external interrupt
config 2ND_LVL_INTR_00_OFFSET
	default 9

config 2ND_LEVEL_INTERRUPT_BITS
	default 11

config MAX_IRQ_PER_AGGREGATOR
	default 512

config NUM_IRQS
	default 524

if SMP

config MP_MAX_NUM_CPUS
	default 16

config PM_CPU_OPS
	default y

choice RISCV_SMP_IPI_IMPL
	default RISCV_SMP_IPI_SBI
endchoice

endif # SMP

if UART_NS16550

config UART_NS16550_XSCALE
	default y

config UART_NS16550_ACCESS_WORD_ONLY
	default y

endif # UART_NS16550

endif # SOC_SPACEMIT_K3
```

## soc/spacemit/k3/Kconfig.soc
```kconfig
# SPDX-FileCopyrightText: Copyright The Zephyr Project Contributors
# SPDX-License-Identifier: Apache-2.0

config SOC_SPACEMIT_K3
	bool
	help
	  SpacemiT K3

config SOC
	default "spacemit_k3" if SOC_SPACEMIT_K3
```
